## Kconfig
```kconfig
menuconfig LKM
	bool "LKM"
	default y

if LKM

config LKM_UDP
	tristate "user interface by UDP"
	default m

config LKM_CDEV
	tristate "user interface by char device"
	default m

config LKM_NETLINK
	tristate "user interface by netlink"
	default m

config LKM_IOCTL
	tristate "user interface by ioctl"
	default m

config LKM_DEBUGFS
	tristate "user interface by debugfs"
	default m

config LKM_MMAP
	tristate "user interface by mmap"
	default m

config LKM_PROC
	tristate "user interface by proc"
	default m

config LKM_SIGNAL
	tristate "user interface by signal"
	default m

config LKM_SYSCTL
	tristate "user interface by sysctl"
	default m

config LKM_SYSFS
	tristate "user interface by sysfs"
	default m

endif # LKM
```
